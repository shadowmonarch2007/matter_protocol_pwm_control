## sdkconfig.defaults
```kconfig
CONFIG_ESPTOOLPY_FLASHSIZE_4MB=y

#enable BT
CONFIG_BT_ENABLED=y
CONFIG_BT_NIMBLE_ENABLED=y

#disable BT connection reattempt
CONFIG_BT_NIMBLE_ENABLE_CONN_REATTEMPT=n

#enable lwip ipv6 autoconfig
CONFIG_LWIP_IPV6_AUTOCONFIG=y

# Use a custom partition table
CONFIG_PARTITION_TABLE_CUSTOM=y
CONFIG_PARTITION_TABLE_FILENAME="partitions.csv"
CONFIG_PARTITION_TABLE_OFFSET=0xC000

# Enable chip shell
CONFIG_ENABLE_CHIP_SHELL=y

CONFIG_ENABLE_WIFI_AP=n

#enable lwIP route hooks
CONFIG_LWIP_HOOK_IP6_ROUTE_DEFAULT=y
CONFIG_LWIP_HOOK_ND6_GET_GW_DEFAULT=y

# This example uses 3 dynamic endpoints (3 PWM channels)
CONFIG_ESP_MATTER_MAX_DYNAMIC_ENDPOINT_COUNT=3

# Button
CONFIG_BUTTON_PERIOD_TIME_MS=20
CONFIG_BUTTON_LONG_PRESS_TIME_MS=5000

# disable softap by default
CONFIG_ESP_WIFI_SOFTAP_SUPPORT=n

# Enable OTA Requestor
CONFIG_ENABLE_OTA_REQUESTOR=y

# Enable HKDF in mbedtls
CONFIG_MBEDTLS_HKDF_C=y

# Increase LwIP IPv6 address number to 6 (MAX_FABRIC + 1)
# unique local addresses for fabrics(MAX_FABRIC), a link local address(1)
CONFIG_LWIP_IPV6_NUM_ADDRESSES=6

# Default WiFi credentials (for testing - will be overridden during commissioning)
# Replace with your WiFi SSID and password
# CONFIG_DEFAULT_WIFI_SSID="YourWiFiSSID"
# CONFIG_DEFAULT_WIFI_PASSWORD="YourWiFiPassword"

# Exclude unused clusters to optimize flash and memory usage
CONFIG_SUPPORT_ACCOUNT_LOGIN_CLUSTER=n
CONFIG_SUPPORT_ACTIVATED_CARBON_FILTER_MONITORING_CLUSTER=n
CONFIG_SUPPORT_AIR_QUALITY_CLUSTER=n
CONFIG_SUPPORT_APPLICATION_BASIC_CLUSTER=n
CONFIG_SUPPORT_APPLICATION_LAUNCHER_CLUSTER=n
CONFIG_SUPPORT_AUDIO_OUTPUT_CLUSTER=n
CONFIG_SUPPORT_BOOLEAN_STATE_CONFIGURATION_CLUSTER=n
CONFIG_SUPPORT_BRIDGED_DEVICE_BASIC_INFORMATION_CLUSTER=n
CONFIG_SUPPORT_CAMERA_AV_SETTINGS_USER_LEVEL_MANAGEMENT_CLUSTER=n
CONFIG_SUPPORT_CARBON_DIOXIDE_CONCENTRATION_MEASUREMENT_CLUSTER=n
CONFIG_SUPPORT_CARBON_MONOXIDE_CONCENTRATION_MEASUREMENT_CLUSTER=n
CONFIG_SUPPORT_CHANNEL_CLUSTER=n
CONFIG_SUPPORT_CHIME_CLUSTER=n
CONFIG_SUPPORT_CLOSURE_CONTROL_CLUSTER=n
CONFIG_SUPPORT_CLOSURE_DIMENSION_CLUSTER=n
CONFIG_SUPPORT_COMMISSIONER_CONTROL_CLUSTER=n
CONFIG_SUPPORT_CONTENT_LAUNCHER_CLUSTER=n
CONFIG_SUPPORT_CONTENT_CONTROL_CLUSTER=n
CONFIG_SUPPORT_CONTENT_APP_OBSERVER_CLUSTER=n
CONFIG_SUPPORT_DEVICE_ENERGY_MANAGEMENT_CLUSTER=n
CONFIG_SUPPORT_DEVICE_ENERGY_MANAGEMENT_MODE_CLUSTER=n
CONFIG_SUPPORT_DIAGNOSTIC_LOGS_CLUSTER=n
CONFIG_SUPPORT_DISHWASHER_ALARM_CLUSTER=n
CONFIG_SUPPORT_DISHWASHER_MODE_CLUSTER=n
CONFIG_SUPPORT_MICROWAVE_OVEN_MODE_CLUSTER=n
CONFIG_SUPPORT_DOOR_LOCK_CLUSTER=n
CONFIG_SUPPORT_ECOSYSTEM_INFORMATION_CLUSTER=n
CONFIG_SUPPORT_ELECTRICAL_ENERGY_MEASUREMENT_CLUSTER=n
CONFIG_SUPPORT_ELECTRICAL_POWER_MEASUREMENT_CLUSTER=n
CONFIG_SUPPORT_ENERGY_EVSE_CLUSTER=n
CONFIG_SUPPORT_ENERGY_EVSE_MODE_CLUSTER=n
CONFIG_SUPPORT_ENERGY_PREFERENCE_CLUSTER=n
CONFIG_SUPPORT_FAN_CONTROL_CLUSTER=n
CONFIG_SUPPORT_FAULT_INJECTION_CLUSTER=n
CONFIG_SUPPORT_FIXED_LABEL_CLUSTER=n
CONFIG_SUPPORT_FORMALDEHYDE_CONCENTRATION_MEASUREMENT_CLUSTER=n
CONFIG_SUPPORT_HEPA_FILTER_MONITORING_CLUSTER=n
CONFIG_SUPPORT_ICD_MANAGEMENT_CLUSTER=n
CONFIG_SUPPORT_KEYPAD_INPUT_CLUSTER=n
CONFIG_SUPPORT_LAUNDRY_WASHER_MODE_CLUSTER=n
CONFIG_SUPPORT_LOCALIZATION_CONFIGURATION_CLUSTER=n
CONFIG_SUPPORT_LOW_POWER_CLUSTER=n
CONFIG_SUPPORT_MEDIA_INPUT_CLUSTER=n
CONFIG_SUPPORT_MEDIA_PLAYBACK_CLUSTER=n
CONFIG_SUPPORT_MICROWAVE_OVEN_CONTROL_CLUSTER=n
CONFIG_SUPPORT_MESSAGES_CLUSTER=n
CONFIG_SUPPORT_MODE_SELECT_CLUSTER=n
CONFIG_SUPPORT_NITROGEN_DIOXIDE_CONCENTRATION_MEASUREMENT_CLUSTER=n
CONFIG_SUPPORT_SAMPLE_MEI_CLUSTER=n
CONFIG_SUPPORT_OCCUPANCY_SENSING_CLUSTER=n
CONFIG_SUPPORT_POWER_TOPOLOGY_CLUSTER=n
CONFIG_SUPPORT_OPERATIONAL_STATE_CLUSTER=n
CONFIG_SUPPORT_OPERATIONAL_STATE_OVEN_CLUSTER=n
CONFIG_SUPPORT_OPERATIONAL_STATE_RVC_CLUSTER=n
CONFIG_SUPPORT_OVEN_MODE_CLUSTER=n
CONFIG_SUPPORT_OZONE_CONCENTRATION_MEASUREMENT_CLUSTER=n
CONFIG_SUPPORT_PM10_CONCENTRATION_MEASUREMENT_CLUSTER=n
CONFIG_SUPPORT_PM1_CONCENTRATION_MEASUREMENT_CLUSTER=n
CONFIG_SUPPORT_PM2_5_CONCENTRATION_MEASUREMENT_CLUSTER=n
CONFIG_SUPPORT_POWER_SOURCE_CLUSTER=n
CONFIG_SUPPORT_POWER_SOURCE_CONFIGURATION_CLUSTER=n
CONFIG_SUPPORT_PUMP_CONFIGURATION_AND_CONTROL_CLUSTER=n
CONFIG_SUPPORT_RADON_CONCENTRATION_MEASUREMENT_CLUSTER=n
CONFIG_SUPPORT_REFRIGERATOR_ALARM_CLUSTER=n
CONFIG_SUPPORT_REFRIGERATOR_AND_TEMPERATURE_CONTROLLED_CABINET_MODE_CLUSTER=n
CONFIG_SUPPORT_RVC_CLEAN_MODE_CLUSTER=n
CONFIG_SUPPORT_RVC_RUN_MODE_CLUSTER=n
CONFIG_SUPPORT_SERVICE_AREA_CLUSTER=n
CONFIG_SUPPORT_SMOKE_CO_ALARM_CLUSTER=n
CONFIG_SUPPORT_SOFTWARE_DIAGNOSTICS_CLUSTER=n
CONFIG_SUPPORT_SWITCH_CLUSTER=n
CONFIG_SUPPORT_TARGET_NAVIGATOR_CLUSTER=n
CONFIG_SUPPORT_TEMPERATURE_CONTROL_CLUSTER=n
CONFIG_SUPPORT_THERMOSTAT_CLUSTER=n
CONFIG_SUPPORT_THERMOSTAT_USER_INTERFACE_CONFIGURATION_CLUSTER=n
CONFIG_SUPPORT_THREAD_BORDER_ROUTER_MANAGEMENT_CLUSTER=n
CONFIG_SUPPORT_THREAD_NETWORK_DIRECTORY_CLUSTER=n
CONFIG_SUPPORT_TIME_FORMAT_LOCALIZATION_CLUSTER=n
CONFIG_SUPPORT_TIME_SYNCHRONIZATION_CLUSTER=n
CONFIG_SUPPORT_TIMER_CLUSTER=n
CONFIG_SUPPORT_TVOC_CONCENTRATION_MEASUREMENT_CLUSTER=n
CONFIG_SUPPORT_UNIT_TESTING_CLUSTER=n
CONFIG_SUPPORT_USER_LABEL_CLUSTER=n
CONFIG_SUPPORT_VALVE_CONFIGURATION_AND_CONTROL_CLUSTER=n
CONFIG_SUPPORT_WAKE_ON_LAN_CLUSTER=n
CONFIG_SUPPORT_LAUNDRY_WASHER_CONTROLS_CLUSTER=n
CONFIG_SUPPORT_LAUNDRY_DRYER_CONTROLS_CLUSTER=n
CONFIG_SUPPORT_WIFI_NETWORK_MANAGEMENT_CLUSTER=n
CONFIG_SUPPORT_WINDOW_COVERING_CLUSTER=n
CONFIG_SUPPORT_WATER_HEATER_MANAGEMENT_CLUSTER=n
CONFIG_SUPPORT_WATER_HEATER_MODE_CLUSTER=n
CONFIG_SUPPORT_ELECTRICAL_GRID_CONDITIONS_CLUSTER=n
CONFIG_SUPPORT_COMMODITY_PRICE_CLUSTER=n
CONFIG_SUPPORT_METER_IDENTIFICATION_CLUSTER=n
CONFIG_SUPPORT_UNIT_LOCALIZATION_CLUSTER=n
CONFIG_SUPPORT_COMMODITY_METERING_CLUSTER=n
CONFIG_SUPPORT_COMMODITY_TARIFF_CLUSTER=n
CONFIG_SUPPORT_PUSH_AV_STREAM_TRANSPORT_CLUSTER=n

# ============================================================================
# COMMISSIONING OPTIMIZATION SETTINGS
# ============================================================================

# Network Timeout Configurations (for mobile hotspot stability)
# Increase WiFi connection timeout from default 10s to 30s
CONFIG_ESP_WIFI_CONNECT_TIMEOUT_MS=30000

# Disable DHCP ARP check to speed up IP assignment
CONFIG_LWIP_DHCP_DOES_ARP_CHECK=n

# Increase TCP timeouts for slow/unstable networks
CONFIG_LWIP_TCP_SYNMAXRTX=12
CONFIG_LWIP_TCP_MSL=60000
CONFIG_LWIP_TCP_FIN_WAIT_TIMEOUT=20000

# Enable WiFi power management for connection stability
CONFIG_ESP_WIFI_STA_DISCONNECTED_PM_ENABLE=y

# BLE Commissioning Optimizations
# Increase BLE MTU for faster data transfer during commissioning
CONFIG_BT_NIMBLE_ATT_PREFERRED_MTU=512

# Increase BLE event buffer for better handling
CONFIG_BT_NIMBLE_HCI_EVT_BUF_SIZE=128

# Optimize BLE connection intervals (in units of 1.25ms)
# Min: 24 * 1.25ms = 30ms, Max: 40 * 1.25ms = 50ms
CONFIG_BT_NIMBLE_CONN_INT_MIN=24
CONFIG_BT_NIMBLE_CONN_INT_MAX=40

# Debug Logging (enable for troubleshooting, disable for production)
# Uncomment these lines to enable verbose logging during commissioning
# CONFIG_LOG_DEFAULT_LEVEL_DEBUG=y
# CONFIG_BT_NIMBLE_LOG_LEVEL_DEBUG=y
# CONFIG_ESP_WIFI_DEBUG_PRINT=y

# Matter/CHIP specific timeouts
# Increase session establishment timeout to 60 seconds (default is 30s)
CONFIG_CHIP_SESSION_ESTABLISHMENT_TIMEOUT=60000

# ============================================================================
# WiFi COEXISTENCE OPTIMIZATION (Fix for AUTH_EXPIRE timeout)
# ============================================================================

# WiFi Authentication and Association Timeouts
# Increase auth timeout to handle coexistence delays (default: 6 beacons)
CONFIG_ESP_WIFI_AUTH_TIMEOUT=12

# Increase connection retry count
CONFIG_ESP_WIFI_MAX_CONN_RETRY=5

# WiFi Scan optimization for faster AP discovery
CONFIG_ESP_WIFI_SCAN_METHOD_ALL_CHANNEL=y
CONFIG_ESP_WIFI_SCAN_CACHE_SIZE=4

# WiFi reconnection settings
# Increase reconnection interval to reduce radio contention
CONFIG_ESP_WIFI_RECONNECT_INTERVAL_MS=500

# WiFi task priority (higher = more priority during coexistence)
# Give WiFi higher priority during connection phase
CONFIG_ESP_WIFI_TASK_CORE_ID=0
CONFIG_ESP_WIFI_TASK_PINNED_TO_CORE=y

# Optimize WiFi RX/TX buffers for coexistence
# Already set in main config but ensuring they're adequate
CONFIG_ESP_WIFI_STATIC_RX_BUFFER_NUM=10
CONFIG_ESP_WIFI_DYNAMIC_RX_BUFFER_NUM=32
CONFIG_ESP_WIFI_DYNAMIC_TX_BUFFER_NUM=32

# WiFi Listen Interval (reduce to get beacons more frequently)
# This helps maintain connection during coexistence
CONFIG_ESP_WIFI_LISTEN_INTERVAL=3

# Coexistence preference - prioritize WiFi during connection
# SW_COEXIST_PREFERENCE_WIFI gives WiFi higher priority
CONFIG_ESP_COEX_SW_COEXIST_PREFERENCE_WIFI=y

# ============================================================================
# MATTER CASE SESSION OPTIMIZATION (Fix for Session Timeout)
# ============================================================================

# CASE Session Timeout - Increase from default 30s to 90s
# Handles slow commissioner responses during certificate exchange
CONFIG_CASE_SESSION_RESUME_TIMEOUT=90000

# Message Reliability Protocol (MRP) Settings
# Increase max retries from 4 to 8 for unreliable networks
CONFIG_CHIP_CONFIG_MRP_LOCAL_ACTIVE_RETRY_INTERVAL=300
CONFIG_CHIP_CONFIG_MRP_LOCAL_IDLE_RETRY_INTERVAL=500

# Exchange timeout - increase from default
CONFIG_CHIP_CONFIG_MRP_EXCHANGE_TIMEOUT=4000

# Device attestation timeout - increase for slow operations
CONFIG_CHIP_DEVICE_CONFIG_DEVICE_ATTESTATION_VERIFICATION_TIMEOUT=10000

# ============================================================================
# MOBILE HOTSPOT COMPATIBILITY (Fix for unstable mobile AP connections)
# ============================================================================

# Disable PMF (Protected Management Frames) - many mobile hotspots don't support this
CONFIG_ESP_WIFI_SOFTAP_SAE_SUPPORT=n
CONFIG_ESP_WIFI_ENABLE_WPA3_SAE=n

# Aggressive WiFi scanning for mobile hotspots that may disappear
CONFIG_ESP_WIFI_SCAN_PREFERRED_MIN_RSSI=-90
CONFIG_ESP_WIFI_SCAN_RSSI_THRESHOLD=-90

# Increase beacon timeout - mobile hotspots can be slow
CONFIG_ESP_WIFI_BEACON_TIMEOUT=10

# Disable WiFi power save during connection for stability
# Re-enable after connection for power efficiency
CONFIG_ESP_WIFI_STA_DISCONNECTED_PM_ENABLE=n

# Increase connection timeout from 30s to 45s for slow mobile hotspots
CONFIG_ESP_WIFI_CONNECT_TIMEOUT_MS=45000

# Connection failure threshold - more tolerant
CONFIG_ESP_WIFI_CONNECTION_LOSS_THRESHOLD=15

# DHCP retry settings for slow mobile hotspot DHCP servers
CONFIG_LWIP_DHCP_MAX_NTP_SERVERS=3
CONFIG_LWIP_DHCP_GET_NTP_SRV=y

# ============================================================================
# ESP RAINMAKER INTEGRATION
# ============================================================================

# Enable ESP RainMaker
CONFIG_ESP_RMAKER_WORK_QUEUE_TASK_STACK=4096

# RainMaker Cloud Configuration
CONFIG_ESP_RMAKER_MAX_MQTT_SUBSCRIPTIONS=8
CONFIG_ESP_RMAKER_MQTT_SEND_USERNAME=y

# Enable RainMaker Scheduling
CONFIG_ESP_RMAKER_SCHEDULING_ENABLED=y

# Enable RainMaker Scenes
CONFIG_ESP_RMAKER_SCENES_ENABLED=y

# Enable RainMaker System Service for diagnostics
CONFIG_ESP_RMAKER_SYSTEM_SERV_ENABLED=y

# Set RainMaker claim URL (for claiming device)
CONFIG_ESP_RMAKER_CLAIM_SERVICE_BASE_URL="https://esp-claiming.rainmaker.espressif.com"

# Enable automatic time sync for RainMaker
CONFIG_ESP_RMAKER_SNTP_ENABLED=y

# RainMaker MQTT Configuration
CONFIG_ESP_RMAKER_MQTT_GLUE_LIB_ENABLE=y
CONFIG_ESP_RMAKER_MQTT_PORT=8883
CONFIG_ESP_RMAKER_MQTT_PERSISTENT_SESSION=y

# Enable insights for diagnostics
CONFIG_ESP_INSIGHTS_ENABLED=y
```
